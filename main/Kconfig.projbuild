## main/Kconfig.projbuild
```kconfig
menu "Carbot micro-ROS settings"

    config CARBOT_MICRO_ROS_ENABLED
        bool "Enable micro-ROS cmd_vel bridge"
        default y

    config CARBOT_MICRO_ROS_TASK_STACK
        int "micro-ROS task stack (bytes)"
        default 16384
        range 4096 65536

    config CARBOT_MICRO_ROS_TASK_PRIO
        int "micro-ROS task priority"
        default 5
        range 1 24

    config CARBOT_MICRO_ROS_DOMAIN_ID
        int "ROS domain id"
        default 0
        range 0 232

    config CARBOT_MICRO_ROS_NAMESPACE
        string "ROS namespace"
        default ""

    config CARBOT_MICRO_ROS_CMD_VEL_TIMEOUT_MS
        int "cmd_vel timeout (ms)"
        default 500
        range 50 10000

    config CARBOT_MICRO_ROS_WATCHDOG_PERIOD_MS
        int "cmd_vel watchdog polling period (ms)"
        default 10
        range 1 100

    config CARBOT_MICRO_ROS_WATCHDOG_TASK_STACK
        int "cmd_vel watchdog task stack (bytes)"
        default 3072
        range 2048 8192

    config CARBOT_MICRO_ROS_WATCHDOG_TASK_PRIO
        int "cmd_vel watchdog task priority"
        default 6
        range 1 24

    config CARBOT_MICRO_ROS_SPIN_PERIOD_MS
        int "Executor spin period (ms)"
        default 50
        range 5 1000

    config CARBOT_MICRO_ROS_HEALTH_CHECK_INTERVAL_MS
        int "Connected Agent health-check interval (ms)"
        default 5000
        range 1000 60000

    config CARBOT_MICRO_ROS_HEALTH_CHECK_TIMEOUT_MS
        int "Agent health-check attempt timeout (ms)"
        default 150
        range 25 400

    config CARBOT_MICRO_ROS_HEALTH_CHECK_ATTEMPTS
        int "Attempts per Agent health check"
        default 2
        range 1 3

    config CARBOT_MICRO_ROS_HEALTH_CHECK_FAILURE_LIMIT
        int "Consecutive failed health checks before reconnect"
        default 3
        range 2 10

    config CARBOT_MICRO_ROS_TIME_SYNC_INTERVAL_MS
        int "Connected session time resynchronization interval (ms)"
        default 60000
        range 10000 3600000

    config CARBOT_MICRO_ROS_TIME_SYNC_TIMEOUT_MS
        int "Time resynchronization timeout (ms)"
        default 50
        range 10 250

    config CARBOT_MICRO_ROS_TIME_SLEW_PPM
        int "Maximum ROS clock offset correction rate (ppm)"
        default 1000
        range 1 100000

endmenu
```

## sdkconfig.defaults
```kconfig
CONFIG_ESPTOOLPY_FLASHSIZE_4MB=y
CONFIG_PARTITION_TABLE_SINGLE_APP_LARGE=y
CONFIG_COMPILER_OPTIMIZATION_SIZE=y
CONFIG_ESP_CONSOLE_NONE=y
CONFIG_ESP_CONSOLE_SECONDARY_USB_SERIAL_JTAG=y
CONFIG_LOG_DEFAULT_LEVEL_INFO=y
CONFIG_LOG_MAXIMUM_LEVEL_INFO=y
```
